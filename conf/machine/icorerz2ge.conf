## conf/machine/icorerz2ge.conf
```bitbake
#@TYPE: Machine
#@NAME: i.Core RZ2GE machine
#@DESCRIPTION: Machine configuration for running i.Core RZ2GE

SOC_FAMILY = "r8a774c0"

DEFAULTTUNE ?= "cortexa53"
require conf/machine/include/tune-cortexa53.inc
require conf/machine/include/${SOC_FAMILY}.inc

# 32BIT package install (default is disable)
# This variables can be used only in multilib.
USE_32BIT_PKGS ?= "0"
USE_32BIT_WAYLAND ?= "0"
USE_32BIT_MMP ?= "0"

MACHINE_FEATURES = ""

KERNEL_IMAGETYPE = "Image"
IMAGE_FSTYPES_append = " tar.bz2 ext4"

SERIAL_CONSOLE = "115200 ttySC0"

# Configuration for kernel
PREFERRED_PROVIDER_virtual/kernel = "linux-renesas"
# Device tree for RZG2E
KERNEL_DEVICETREE = " \
    engicam/icore-rzg2e.dtb \
"

# Configuration for ARM Trusted Firmware
EXTRA_IMAGEDEPENDS += " arm-trusted-firmware"

# u-boot
PREFERRED_VERSION_u-boot = "v2018.09%"
EXTRA_IMAGEDEPENDS += " u-boot"
# G2E u-boot configure
UBOOT_CONFIG ??= "icore"
UBOOT_CONFIG[icore] = "icorerzg2e_defconfig"

# libdrm
PREFERRED_VERSION_libdrm = "2.4.85"

# Add variable to Build Configuration in build log
BUILDCFG_VARS_append = " SOC_FAMILY"

# Command using to build kernel-module-gles
HOSTTOOLS += "sync"
```
